// SPDX-License-Identifier: GPL-2.0-only
/*
 * Handsome OpenStick UFI103s - Venus + 4G + Adreno GPU 板型
 *
 * CPU OC 已全员化（common dtsi）。本板型额外启用
 * Adreno 306 GPU。这台设备没有显示面板，所以 GPU 只用来出 render 节点：
 *
 *   &gpu 在 msm8916.dtsi 里是 status="disabled"，这里置为 okay 后内核会为该
 *   platform device 建立设备（由 qcom,adreno-306.0 匹配），再由 msm.ko 接管。
 *
 * 需要配套的内核配置（source/configs/ufi103s-gpu.config）与模块参数
 *   options msm separate_gpu_kms=1
 * 才会生成 /dev/dri/renderD128（render-only，无 KMS）。
 */

#include "msm8916-handsome-openstick-ufi103s-venus-4g.dts"

/*
 * Adreno 306。设备树里 gpu 节点带 clocks / power-domain(OXILI_GDSC) /
 * operating-points-v2 / iommus，均已由 msm8916.dtsi 提供，这里只打开状态。
 */
&gpu {
	status = "okay";
};
