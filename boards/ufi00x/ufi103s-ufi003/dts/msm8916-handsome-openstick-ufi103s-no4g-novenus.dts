// SPDX-License-Identifier: GPL-2.0-only
/*
 * Handsome OpenStick UFI103s - WiFi-only memory variant (no 4G, no Venus)
 *
 * 在 venus-no4g 的基础上把硬件编解码也去掉，只保留 Wi-Fi/BT（WCNSS）。
 * 用途：最小内存形态的 boot 侧配套 DTB（配 tiny 档 rootfs）。
 *
 * 相对在跑的 venus 镜像，累计回收的 memblock no-map 预留：
 *   mpss_mem   85.0 MiB   modem（venus-no4g 已含）
 *   mba_mem     1.0 MiB   modem boot authenticator（同上）
 *   rmtfs       0.9 MiB   modem NV 后备（同上）
 *   venus_mem   5.0 MiB   硬件编解码专用连续内存 —— 本变体新增
 *   合计       86.9 + 5.0 MiB
 *
 * 保留：wcnss_mem（动态分配 6 MiB，Wi-Fi/BT 固件；WCNSS 是 combo 芯片，
 * BT 与 Wi-Fi 共用）、TZ/SMEM/HYP 固件强制块（~7 MiB）、CMA（计入
 * MemTotal/available，空闲时就是普通内存，不减不增）。
 *
 * 注意：venus.dts 先把 &venus/&venus_mem 置 okay，dtc 合并时后引用者胜，
 * 所以本文件的 disabled 必须写在 include 之后（正是现在的顺序）。
 */

#include "msm8916-handsome-openstick-ufi103s-venus-no4g.dts"

&venus {
	status = "disabled";
};

&venus_mem {
	status = "disabled";
};
